## scripts/r1-linux-multiv7-v9-emmc-wifi-scan-a3b.its
```
/dts-v1/;

/* Wi-Fi A3b: verified A3a plus a BSSID-redacting nl80211 scan tool. */
/ {
	description = "Phicomm R1 Linux 5.10 Wi-Fi scan A3b";
	#address-cells = <1>;

	images {
		kernel {
			description = "Linux 5.10.262 multi_v7 four-core Wi-Fi A3a kernel";
			data = /incbin/("../build/artifacts/zImage-5.10-multiv7-v9-wifi-a3");
			type = "kernel";
			arch = "arm";
			os = "linux";
			compression = "none";
			load = <0x62000000>;
			entry = <0x62000000>;
			hash-1 { algo = "sha256"; };
		};

		ramdisk {
			description = "R1 A3 regulatory initramfs plus minimal nl80211 scanner";
			data = /incbin/("../build/artifacts/r1-initramfs-wifi-a3b.cpio.gz");
			type = "ramdisk";
			arch = "arm";
			os = "linux";
			compression = "none";
			load = <0x64000000>;
			hash-1 { algo = "sha256"; };
		};

		fdt {
			description = "R1 verified Wi-Fi SDIO A1 hardware DT";
			data = /incbin/("../build/artifacts/rk3229-phicomm-r1-emmc-open-optee-wifi-sdio-a1.dtb");
			type = "flat_dt";
			arch = "arm";
			compression = "none";
			load = <0x65000000>;
			hash-1 { algo = "sha256"; };
		};
	};

	configurations {
		default = "config-1";

		config-1 {
			description = "R1 Wi-Fi read-only scan A3b";
			kernel = "kernel";
			ramdisk = "ramdisk";
			fdt = "fdt";
		};
	};
};
```

## scripts/r1-linux-multiv7-v9-emmc-wifi-sdio-a1.its
```
/dts-v1/;

/* Wi-Fi A1: exact C1 kernel/initramfs, only the SDIO DT changes. */
/ {
	description = "Phicomm R1 Linux 5.10 C1 plus Wi-Fi SDIO A1";
	#address-cells = <1>;

	images {
		kernel {
			description = "Verified Linux 5.10.262 multi_v7 clean four-core v9";
			data = /incbin/("../build/artifacts/zImage-5.10-psci-v1-gic400-clean-4core-v9");
			type = "kernel";
			arch = "arm";
			os = "linux";
			compression = "none";
			load = <0x62000000>;
			entry = <0x62000000>;
			hash-1 { algo = "sha256"; };
		};

		ramdisk {
			description = "R1 rescue initramfs with basic applets";
			data = /incbin/("../build/artifacts/r1-initramfs-rescue-v11-emmc-a2.cpio.gz");
			type = "ramdisk";
			arch = "arm";
			os = "linux";
			compression = "none";
			load = <0x64000000>;
			hash-1 { algo = "sha256"; };
		};

		fdt {
			description = "Verified eMMC C1 DT plus soldered Wi-Fi SDIO";
			data = /incbin/("../build/artifacts/rk3229-phicomm-r1-emmc-open-optee-wifi-sdio-a1.dtb");
			type = "flat_dt";
			arch = "arm";
			compression = "none";
			load = <0x65000000>;
			hash-1 { algo = "sha256"; };
		};
	};

	configurations {
		default = "config-1";

		config-1 {
			description = "R1 C1 plus Wi-Fi SDIO A1";
			kernel = "kernel";
			ramdisk = "ramdisk";
			fdt = "fdt";
		};
	};
};
```

## scripts/r1-linux-multiv7-v9-wifi-bt-audio-ak7755-a2.its
```
/dts-v1/;

/ {
	description = "Phicomm R1 Linux 5.10 AK7755EN identity A2";
	#address-cells = <1>;

	images {
		kernel-1 {
			description = "Linux 5.10.262 R1 Bluetooth CMAC/AES built-in";
			data = /incbin/("../build/artifacts/zImage-wifi-bt-mgmt-a1r9");
			type = "kernel";
			arch = "arm";
			os = "linux";
			compression = "none";
			load = <0x62000000>;
			entry = <0x62000000>;
			hash-1 { algo = "sha256"; };
		};

		ramdisk-1 {
			description = "R1 rescue initramfs with AK7755EN identity tool";
			data = /incbin/("../build/artifacts/r1-initramfs-wifi-bt-audio-ak7755-a2.cpio.gz");
			type = "ramdisk";
			arch = "arm";
			os = "linux";
			compression = "gzip";
			hash-1 { algo = "sha256"; };
		};

		fdt-1 {
			description = "Phicomm R1 safe amplifier GPIO plus AK7755EN PDN DTB";
			data = /incbin/("../build/artifacts/rk3229-phicomm-r1-wifi-bt-audio-ak7755-a2.dtb");
			type = "flat_dt";
			arch = "arm";
			compression = "none";
			hash-1 { algo = "sha256"; };
		};
	};

	configurations {
		default = "config-1";
		config-1 {
			description = "R1 AK7755EN 0x60 identity-read A2";
			kernel = "kernel-1";
			ramdisk = "ramdisk-1";
			fdt = "fdt-1";
		};
	};
};
```

## scripts/r1-linux-multiv7-v9-wifi-bt-audio-i2c-a1.its
```
/dts-v1/;

/ {
	description = "Phicomm R1 Linux 5.10 Wi-Fi Bluetooth + AK7755EN I2C A1";
	#address-cells = <1>;

	images {
		kernel-1 {
			description = "Linux 5.10.262 R1 Bluetooth CMAC/AES built-in";
			data = /incbin/("../build/artifacts/zImage-wifi-bt-mgmt-a1r9");
			type = "kernel";
			arch = "arm";
			os = "linux";
			compression = "none";
			load = <0x62000000>;
			entry = <0x62000000>;
			hash-1 { algo = "sha256"; };
		};

		ramdisk-1 {
			description = "R1 rescue initramfs with Wi-Fi and Bluetooth scan tools";
			data = /incbin/("../build/artifacts/r1-initramfs-wifi-bt-mgmt-a1r8.cpio.gz");
			type = "ramdisk";
			arch = "arm";
			os = "linux";
			compression = "gzip";
			hash-1 { algo = "sha256"; };
		};

		fdt-1 {
			description = "Phicomm R1 AK7755EN I2C1 controller-only DTB";
			data = /incbin/("../build/artifacts/rk3229-phicomm-r1-wifi-bt-audio-i2c-a1.dtb");
			type = "flat_dt";
			arch = "arm";
			compression = "none";
			hash-1 { algo = "sha256"; };
		};
	};

	configurations {
		default = "config-1";
		config-1 {
			description = "R1 A1r9 plus controller-only AK7755EN I2C1";
			kernel = "kernel-1";
			ramdisk = "ramdisk-1";
			fdt = "fdt-1";
		};
	};
};
```

## scripts/r1-linux-multiv7-v9-wifi-bt-serdev-a1r6.its
```
/dts-v1/;

/ {
	description = "Phicomm R1 Linux 5.10 AW-CM256SM Bluetooth serdev A1r6";
	#address-cells = <1>;

	images {
		kernel {
			description = "Linux 5.10.262 multi_v7 Wi-Fi plus built-in Broadcom HCI UART";
			data = /incbin/("../build/artifacts/zImage-wifi-bt-serdev-a1r6");
			type = "kernel";
			arch = "arm";
			os = "linux";
			compression = "none";
			load = <0x62000000>;
			entry = <0x62000000>;
			hash-1 { algo = "sha256"; };
		};

		ramdisk {
			description = "R1 rescue initramfs with Wi-Fi data and BCM4345 HCD";
			data = /incbin/("../build/artifacts/r1-initramfs-wifi-bt-serdev-a1r6.cpio.gz");
			type = "ramdisk";
			arch = "arm";
			os = "linux";
			compression = "none";
			load = <0x64000000>;
			hash-1 { algo = "sha256"; };
		};

		fdt {
			description = "R1 AW-CM256SM/CYW43455 serdev DT";
			data = /incbin/("../build/artifacts/rk3229-phicomm-r1-wifi-bt-serdev-a1r6.dtb");
			type = "flat_dt";
			arch = "arm";
			compression = "none";
			load = <0x65000000>;
			hash-1 { algo = "sha256"; };
		};
	};

	configurations {
		default = "config-1";
		config-1 {
			description = "R1 Bluetooth serdev A1r6";
			kernel = "kernel";
			ramdisk = "ramdisk";
			fdt = "fdt";
		};
	};
};
```

## scripts/r1-linux-multiv7-v9-wifi-bt-serdev-a1r7.its
```
/dts-v1/;

/ {
	description = "Phicomm R1 Linux 5.10 AW-CM256SM Bluetooth serdev A1r7";
	#address-cells = <1>;

	images {
		kernel {
			description = "Linux 5.10.262 multi_v7 Wi-Fi plus built-in Broadcom HCI UART";
			data = /incbin/("../build/artifacts/zImage-wifi-bt-serdev-a1r6");
			type = "kernel";
			arch = "arm";
			os = "linux";
			compression = "none";
			load = <0x62000000>;
			entry = <0x62000000>;
			hash-1 { algo = "sha256"; };
		};

		ramdisk {
			description = "R1 rescue initramfs with BCM4345C0 HCD alias";
			data = /incbin/("../build/artifacts/r1-initramfs-wifi-bt-serdev-a1r7.cpio.gz");
			type = "ramdisk";
			arch = "arm";
			os = "linux";
			compression = "none";
			load = <0x64000000>;
			hash-1 { algo = "sha256"; };
		};

		fdt {
			description = "R1 AW-CM256SM/CYW43455 serdev DT";
			data = /incbin/("../build/artifacts/rk3229-phicomm-r1-wifi-bt-serdev-a1r6.dtb");
			type = "flat_dt";
			arch = "arm";
			compression = "none";
			load = <0x65000000>;
			hash-1 { algo = "sha256"; };
		};
	};

	configurations {
		default = "config-1";
		config-1 {
			description = "R1 Bluetooth serdev A1r7 BCM4345C0 HCD";
			kernel = "kernel";
			ramdisk = "ramdisk";
			fdt = "fdt";
		};
	};
};
```

## scripts/r1-linux-multiv7-v9-wifi-bt-uart-a1.its
```
/dts-v1/;

/* Bluetooth A1: verified A3b kernel/userspace plus R1 UART1 alternate pins. */
/ {
	description = "Phicomm R1 Linux 5.10 Bluetooth UART A1";
	#address-cells = <1>;

	images {
		kernel {
			description = "Linux 5.10.262 multi_v7 four-core Wi-Fi A3 kernel";
			data = /incbin/("../build/artifacts/zImage-5.10-multiv7-v9-wifi-a3");
			type = "kernel";
			arch = "arm";
			os = "linux";
			compression = "none";
			load = <0x62000000>;
			entry = <0x62000000>;
			hash-1 { algo = "sha256"; };
		};

		ramdisk {
			description = "R1 Wi-Fi A3b rescue initramfs with timeout applet";
			data = /incbin/("../build/artifacts/r1-initramfs-wifi-bt-uart-a1.cpio.gz");
			type = "ramdisk";
			arch = "arm";
			os = "linux";
			compression = "none";
			load = <0x64000000>;
			hash-1 { algo = "sha256"; };
		};

		fdt {
			description = "R1 Wi-Fi plus Bluetooth UART1 alternate-pin A1 DT";
			data = /incbin/("../build/artifacts/rk3229-phicomm-r1-wifi-bt-uart-a1.dtb");
			type = "flat_dt";
			arch = "arm";
			compression = "none";
			load = <0x65000000>;
			hash-1 { algo = "sha256"; };
		};
	};

	configurations {
		default = "config-1";

		config-1 {
			description = "R1 Bluetooth raw UART A1";
			kernel = "kernel";
			ramdisk = "ramdisk";
			fdt = "fdt";
		};
	};
};
```

## scripts/r1-linux-multiv7-v9-wifi-bt-uart-a1r2.its
```
/dts-v1/;

/* Bluetooth A1r2: fixed-regulator BT_REG_ON after A1 gpio-hog deferral. */
/ {
	description = "Phicomm R1 Linux 5.10 Bluetooth UART A1r2";
	#address-cells = <1>;

	images {
		kernel {
			description = "Linux 5.10.262 multi_v7 four-core Wi-Fi A3 kernel";
			data = /incbin/("../build/artifacts/zImage-5.10-multiv7-v9-wifi-a3");
			type = "kernel";
			arch = "arm";
			os = "linux";
			compression = "none";
			load = <0x62000000>;
			entry = <0x62000000>;
			hash-1 { algo = "sha256"; };
		};

		ramdisk {
			description = "R1 Wi-Fi A3b rescue initramfs with timeout applet";
			data = /incbin/("../build/artifacts/r1-initramfs-wifi-bt-uart-a1.cpio.gz");
			type = "ramdisk";
			arch = "arm";
			os = "linux";
			compression = "none";
			load = <0x64000000>;
			hash-1 { algo = "sha256"; };
		};

		fdt {
			description = "R1 Bluetooth UART A1r2 fixed-regulator DT";
			data = /incbin/("../build/artifacts/rk3229-phicomm-r1-wifi-bt-uart-a1r2.dtb");
			type = "flat_dt";
			arch = "arm";
			compression = "none";
			load = <0x65000000>;
			hash-1 { algo = "sha256"; };
		};
	};

	configurations {
		default = "config-1";

		config-1 {
			description = "R1 Bluetooth raw UART A1r2";
			kernel = "kernel";
			ramdisk = "ramdisk";
			fdt = "fdt";
		};
	};
};
```

## scripts/r1-linux-multiv7-v9-wifi-bt-uart-a1r3.its
```
/dts-v1/;

/* Bluetooth A1r3: A1r2 plus asserted GPIO3_D3 BT_WAKE. */
/ {
	description = "Phicomm R1 Linux 5.10 Bluetooth UART A1r3";
	#address-cells = <1>;

	images {
		kernel {
			description = "Linux 5.10.262 multi_v7 four-core Wi-Fi A3 kernel";
			data = /incbin/("../build/artifacts/zImage-5.10-multiv7-v9-wifi-a3");
			type = "kernel";
			arch = "arm";
			os = "linux";
			compression = "none";
			load = <0x62000000>;
			entry = <0x62000000>;
			hash-1 { algo = "sha256"; };
		};

		ramdisk {
			description = "R1 Wi-Fi A3b rescue initramfs with UART probe applets";
			data = /incbin/("../build/artifacts/r1-initramfs-wifi-bt-uart-a1.cpio.gz");
			type = "ramdisk";
			arch = "arm";
			os = "linux";
			compression = "none";
			load = <0x64000000>;
			hash-1 { algo = "sha256"; };
		};

		fdt {
			description = "R1 Bluetooth UART A1r3 BT_REG_ON plus BT_WAKE DT";
			data = /incbin/("../build/artifacts/rk3229-phicomm-r1-wifi-bt-uart-a1r3.dtb");
			type = "flat_dt";
			arch = "arm";
			compression = "none";
			load = <0x65000000>;
			hash-1 { algo = "sha256"; };
		};
	};

	configurations {
		default = "config-1";

		config-1 {
			description = "R1 Bluetooth raw UART A1r3";
			kernel = "kernel";
			ramdisk = "ramdisk";
			fdt = "fdt";
		};
	};
};
```

## scripts/r1-linux-multiv7-v9-wifi-bt-uart-a1r4.its
```
/dts-v1/;

/* Bluetooth A1r4: A1r3 plus explicitly enabled RK805 CLK32KOUT2. */
/ {
	description = "Phicomm R1 Linux 5.10 Bluetooth UART A1r4";
	#address-cells = <1>;

	images {
		kernel {
			description = "Linux 5.10.262 multi_v7 four-core Wi-Fi A3 plus RK805 clock driver";
			data = /incbin/("../build/artifacts/zImage-wifi-bt-uart-a1r4");
			type = "kernel";
			arch = "arm";
			os = "linux";
			compression = "none";
			load = <0x62000000>;
			entry = <0x62000000>;
			hash-1 { algo = "sha256"; };
		};

		ramdisk {
			description = "R1 Wi-Fi A3b rescue initramfs with UART probe applets";
			data = /incbin/("../build/artifacts/r1-initramfs-wifi-bt-uart-a1.cpio.gz");
			type = "ramdisk";
			arch = "arm";
			os = "linux";
			compression = "none";
			load = <0x64000000>;
			hash-1 { algo = "sha256"; };
		};

		fdt {
			description = "R1 Bluetooth UART A1r4 with RK805 CLK32KOUT2";
			data = /incbin/("../build/artifacts/rk3229-phicomm-r1-wifi-bt-uart-a1r4.dtb");
			type = "flat_dt";
			arch = "arm";
			compression = "none";
			load = <0x65000000>;
			hash-1 { algo = "sha256"; };
		};
	};

	configurations {
		default = "config-1";

		config-1 {
			description = "R1 Bluetooth raw UART A1r4";
			kernel = "kernel";
			ramdisk = "ramdisk";
			fdt = "fdt";
		};
	};
};
```

## scripts/r1-linux-multiv7-v9-wifi-bt-uart-a1r5.its
```
/dts-v1/;

/* AW-CM256SM startup: LPO on, BT_DEV_WAKE low, then BT_REG_ON high. */
/ {
	description = "Phicomm R1 Linux 5.10 Bluetooth UART A1r5";
	#address-cells = <1>;

	images {
		kernel {
			description = "Linux 5.10.262 multi_v7 four-core Wi-Fi A3 plus RK805 clock driver";
			data = /incbin/("../build/artifacts/zImage-wifi-bt-uart-a1r4");
			type = "kernel";
			arch = "arm";
			os = "linux";
			compression = "none";
			load = <0x62000000>;
			entry = <0x62000000>;
			hash-1 { algo = "sha256"; };
		};

		ramdisk {
			description = "R1 Wi-Fi A3b rescue initramfs with UART probe applets";
			data = /incbin/("../build/artifacts/r1-initramfs-wifi-bt-uart-a1.cpio.gz");
			type = "ramdisk";
			arch = "arm";
			os = "linux";
			compression = "none";
			load = <0x64000000>;
			hash-1 { algo = "sha256"; };
		};

		fdt {
			description = "R1 AW-CM256SM ordered Bluetooth startup DT";
			data = /incbin/("../build/artifacts/rk3229-phicomm-r1-wifi-bt-uart-a1r5.dtb");
			type = "flat_dt";
			arch = "arm";
			compression = "none";
			load = <0x65000000>;
			hash-1 { algo = "sha256"; };
		};
	};

	configurations {
		default = "config-1";
		config-1 {
			description = "R1 AW-CM256SM Bluetooth raw UART A1r5";
			kernel = "kernel";
			ramdisk = "ramdisk";
			fdt = "fdt";
		};
	};
};
```

## scripts/r1-linux-rescue-v11-emmc-a2.its
```
/dts-v1/;

/ {
	description = "Phicomm R1 Linux 5.10 rescue v11 eMMC A2";
	#address-cells = <1>;

	images {
		kernel {
			description = "Linux 5.10.262 rescue v11 eMMC";
			data = /incbin/("../build/artifacts/zImage-rescue-v11-emmc-a1");
			type = "kernel";
			arch = "arm";
			os = "linux";
			compression = "none";
			load = <0x62000000>;
			entry = <0x62000000>;
			hash-1 {
				algo = "sha256";
			};
		};

		ramdisk {
			description = "R1 rescue initramfs with basic applets";
			data = /incbin/("../build/artifacts/r1-initramfs-rescue-v11-emmc-a2.cpio.gz");
			type = "ramdisk";
			arch = "arm";
			os = "linux";
			compression = "none";
			load = <0x64000000>;
			hash-1 {
				algo = "sha256";
			};
		};

		fdt {
			description = "R1 eMMC A2 timer-minimal device tree";
			data = /incbin/("../build/artifacts/rk3229-phicomm-r1-rescue-v11-emmc-a2-timer-minimal.dtb");
			type = "flat_dt";
			arch = "arm";
			compression = "none";
			load = <0x65000000>;
			hash-1 {
				algo = "sha256";
			};
		};
	};

	configurations {
		default = "config-1";

		config-1 {
			description = "R1 rescue v11 eMMC A2";
			kernel = "kernel";
			ramdisk = "ramdisk";
			fdt = "fdt";
		};
	};
};
```
