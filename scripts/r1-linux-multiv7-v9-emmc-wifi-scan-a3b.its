## scripts/r1-linux-rescue-v11-emmc-b3-clock-inherit.its
```
/dts-v1/;

/ {
	description = "Phicomm R1 Linux 5.10 rescue v11 eMMC B3 clock-inherit";
	#address-cells = <1>;

	images {
		kernel {
			description = "Linux 5.10.262 rescue v11 eMMC";
			data = /incbin/("../build/artifacts/zImage-rescue-v11-emmc-a1");
			type = "kernel";
			arch = "arm";
			os = "linux";
			compression = "none";
			load = <0x62000000>;
			entry = <0x62000000>;
			hash-1 { algo = "sha256"; };
		};

		ramdisk {
			description = "R1 rescue initramfs with basic applets";
			data = /incbin/("../build/artifacts/r1-initramfs-rescue-v11-emmc-a2.cpio.gz");
			type = "ramdisk";
			arch = "arm";
			os = "linux";
			compression = "none";
			load = <0x64000000>;
			hash-1 { algo = "sha256"; };
		};

		fdt {
			description = "R1 eMMC B3 timer-minimal and inherited clocks";
			data = /incbin/("../build/artifacts/rk3229-phicomm-r1-rescue-v11-emmc-b3-clock-inherit.dtb");
			type = "flat_dt";
			arch = "arm";
			compression = "none";
			load = <0x65000000>;
			hash-1 { algo = "sha256"; };
		};
	};

	configurations {
		default = "config-1";

		config-1 {
			description = "R1 rescue v11 eMMC B3 clock-inherit";
			kernel = "kernel";
			ramdisk = "ramdisk";
			fdt = "fdt";
		};
	};
};
```

## scripts/r1-linux-rescue-v11-emmc-c2-a7-814220.its
```
/dts-v1/;

/ {
	description = "Phicomm R1 Linux 5.10 rescue v11 eMMC C2 ARM 814220";
	#address-cells = <1>;

	images {
		kernel {
			description = "Linux 5.10.262 rescue v11 plus Cortex-A7 erratum 814220";
			data = /incbin/("../build/artifacts/zImage-rescue-v11-emmc-c2-a7-814220");
			type = "kernel";
			arch = "arm";
			os = "linux";
			compression = "none";
			load = <0x62000000>;
			entry = <0x62000000>;
			hash-1 { algo = "sha256"; };
		};

		ramdisk {
			description = "R1 rescue initramfs with basic applets";
			data = /incbin/("../build/artifacts/r1-initramfs-rescue-v11-emmc-a2.cpio.gz");
			type = "ramdisk";
			arch = "arm";
			os = "linux";
			compression = "none";
			load = <0x64000000>;
			hash-1 { algo = "sha256"; };
		};

		fdt {
			description = "R1 eMMC B2 timer-minimal DT";
			data = /incbin/("../build/artifacts/rk3229-phicomm-r1-rescue-v11-emmc-a2-timer-minimal.dtb");
			type = "flat_dt";
			arch = "arm";
			compression = "none";
			load = <0x65000000>;
			hash-1 { algo = "sha256"; };
		};
	};

	configurations {
		default = "config-1";

		config-1 {
			description = "R1 rescue v11 C2 ARM erratum 814220";
			kernel = "kernel";
			ramdisk = "ramdisk";
			fdt = "fdt";
		};
	};
};
```

## scripts/r1-ymodem-fit-dtb-rk-v2.00.its
```
/dts-v1/;

/ {
	description = "Phicomm R1 UART YMODEM FIT with Rockchip RK322x TEE v2.00";
	#address-cells = <1>;

	images {
		u-boot {
			description = "U-Boot proper with appended R1 DTB";
			data = /incbin/("../build/u-boot/u-boot-dtb.bin");
			type = "standalone";
			arch = "arm";
			os = "u-boot";
			compression = "none";
			load = <0x61000000>;
			entry = <0x61000000>;
		};

		op-tee {
			description = "Rockchip RK322x TEE v2.00";
			data = /incbin/("../build/tee/rk322x_tee_v2.00.bin");
			type = "tee";
			arch = "arm";
			os = "tee";
			compression = "none";
			load = <0x68400000>;
			entry = <0x68400000>;
		};

		fdt-1 {
			description = "R1 U-Boot DTB for TEE";
			data = /incbin/("../build/u-boot/u-boot.dtb");
			type = "flat_dt";
			compression = "none";
		};
	};

	configurations {
		default = "config-1";

		config-1 {
			description = "Phicomm R1 Rockchip TEE v2.00 A/B";
			firmware = "op-tee";
			loadables = "u-boot";
			fdt = "fdt-1";
			compatible = "phicomm,r1", "rockchip,rk3229";
		};
	};
};
```

## scripts/r1-ymodem-fit-dtb.its
```
/dts-v1/;

/ {
	description = "Phicomm R1 UART YMODEM FIT with Open-Source OP-TEE";
	#address-cells = <1>;

	images {
		u-boot {
			description = "U-Boot proper with appended R1 DTB";
			data = /incbin/("../build/u-boot/u-boot-dtb.bin");
			type = "standalone";
			arch = "arm";
			os = "u-boot";
			compression = "none";
			load = <0x61000000>;
			entry = <0x61000000>;
		};

		op-tee {
			description = "RK322x Open-Source OP-TEE";
			data = /incbin/("../build/tee/rk322x_tee_os.bin");
			type = "tee";
			arch = "arm";
			os = "tee";
			compression = "none";
			load = <0x68400000>;
			entry = <0x68400000>;
		};

		fdt-1 {
			description = "R1 U-Boot DTB for OP-TEE";
			data = /incbin/("../build/u-boot/u-boot.dtb");
			type = "flat_dt";
			compression = "none";
		};
	};

	configurations {
		default = "config-1";

		config-1 {
			description = "Phicomm R1";
			firmware = "op-tee";
			loadables = "u-boot";
			fdt = "fdt-1";
			compatible = "phicomm,r1", "rockchip,rk3229";
		};
	};
};
```
