## scripts/r1-linux-mainline-6.18-ak7755-fw-a3.its
```
/dts-v1/;

/ {
	description = "Phicomm R1 Linux 6.18 AK7755 safe firmware A3";
	#address-cells = <1>;

	images {
		kernel-1 {
			description = "Linux 6.18.42 R1 four-core Wi-Fi Bluetooth AK7755";
			data = /incbin/("../build/artifacts/zImage-mainline-6.18-ak7755-fw-a3");
			type = "kernel";
			arch = "arm";
			os = "linux";
			compression = "none";
			load = <0x62000000>;
			entry = <0x62000000>;
			hash-1 { algo = "sha256"; };
		};

		ramdisk-1 {
			description = "R1 rescue initramfs with wireless and AK7755 firmware";
			data = /incbin/("../build/artifacts/r1-initramfs-mainline-6.18-ak7755-fw-a3.cpio.gz");
			type = "ramdisk";
			arch = "arm";
			os = "linux";
			compression = "gzip";
			hash-1 { algo = "sha256"; };
		};

		fdt-1 {
			description = "Phicomm R1 open OP-TEE Wi-Fi Bluetooth AK7755 DTB";
			data = /incbin/("../build/artifacts/rk3229-phicomm-r1-mainline-6.18-ak7755-fw-a3.dtb");
			type = "flat_dt";
			arch = "arm";
			compression = "none";
			hash-1 { algo = "sha256"; };
		};
	};

	configurations {
		default = "config-1";
		config-1 {
			description = "R1 Linux 6.18 AK7755 safe firmware A3";
			kernel = "kernel-1";
			ramdisk = "ramdisk-1";
			fdt = "fdt-1";
		};
	};
};
```

## scripts/r1-linux-mainline-6.18-ak7755-i2s-clock-a19.its
```
/dts-v1/;

/ {
	description = "Phicomm R1 Linux 6.18 AK7755 I2S clock A/B A19";
	#address-cells = <1>;

	images {
		kernel-1 {
			description = "Linux 6.18.42 R1 AK7755 A18r3 unchanged kernel";
			data = /incbin/("../build/artifacts/zImage-mainline-6.18-ak7755-lineout-selfcheck-a18r3");
			type = "kernel";
			arch = "arm";
			os = "linux";
			compression = "none";
			load = <0x62000000>;
			entry = <0x62000000>;
			hash-1 { algo = "sha256"; };
		};

		ramdisk-1 {
			description = "R1 rescue initramfs with I2S clock A/B tool";
			data = /incbin/("../build/artifacts/r1-initramfs-mainline-6.18-ak7755-i2s-clock-a19.cpio.gz");
			type = "ramdisk";
			arch = "arm";
			os = "linux";
			compression = "gzip";
			hash-1 { algo = "sha256"; };
		};

		fdt-1 {
			description = "Phicomm R1 AK7755 timeout-backed amplifier gate";
			data = /incbin/("../build/artifacts/rk3229-phicomm-r1-mainline-6.18-ak7755-lineout-selfcheck-a18r3.dtb");
			type = "flat_dt";
			arch = "arm";
			compression = "none";
			hash-1 { algo = "sha256"; };
		};
	};

	configurations {
		default = "config-1";
		config-1 {
			description = "R1 zero PCM I2S running-stopped-running A/B";
			kernel = "kernel-1";
			ramdisk = "ramdisk-1";
			fdt = "fdt-1";
		};
	};
};
```

## scripts/r1-linux-mainline-6.18-ak7755-lineout-selfcheck-a18r2.its
```
/dts-v1/;

/ {
	description = "Phicomm R1 Linux 6.18 AK7755 Lineout1 D4 self-check A18r2";
	#address-cells = <1>;

	images {
		kernel-1 {
			description = "Linux 6.18.42 R1 AK7755 retryable Lineout1 D4 self-check";
			data = /incbin/("../build/artifacts/zImage-mainline-6.18-ak7755-lineout-selfcheck-a18r2");
			type = "kernel";
			arch = "arm";
			os = "linux";
			compression = "none";
			load = <0x62000000>;
			entry = <0x62000000>;
			hash-1 { algo = "sha256"; };
		};

		ramdisk-1 {
			description = "R1 rescue initramfs with AK7755 Lineout1 D4 self-check";
			data = /incbin/("../build/artifacts/r1-initramfs-mainline-6.18-ak7755-lineout-selfcheck-a18r2.cpio.gz");
			type = "ramdisk";
			arch = "arm";
			os = "linux";
			compression = "gzip";
			hash-1 { algo = "sha256"; };
		};

		fdt-1 {
			description = "Phicomm R1 AK7755 timeout-backed amplifier gate";
			data = /incbin/("../build/artifacts/rk3229-phicomm-r1-mainline-6.18-ak7755-lineout-selfcheck-a18r2.dtb");
			type = "flat_dt";
			arch = "arm";
			compression = "none";
			hash-1 { algo = "sha256"; };
		};
	};

	configurations {
		default = "config-1";
		config-1 {
			description = "R1 retryable AK7755 D4 0/-14/-28 dB self-check";
			kernel = "kernel-1";
			ramdisk = "ramdisk-1";
			fdt = "fdt-1";
		};
	};
};
```

## scripts/r1-linux-mainline-6.18-ak7755-lineout-volume-a17.its
```
/dts-v1/;

/ {
	description = "Phicomm R1 Linux 6.18 AK7755 Lineout1 volume A17";
	#address-cells = <1>;

	images {
		kernel-1 {
			description = "Linux 6.18.42 R1 AK7755 Lineout1 volume diagnostic";
			data = /incbin/("../build/artifacts/zImage-mainline-6.18-ak7755-lineout-volume-a17");
			type = "kernel";
			arch = "arm";
			os = "linux";
			compression = "none";
			load = <0x62000000>;
			entry = <0x62000000>;
			hash-1 { algo = "sha256"; };
		};

		ramdisk-1 {
			description = "R1 rescue initramfs with AK7755 Lineout1 volume A/B tool";
			data = /incbin/("../build/artifacts/r1-initramfs-mainline-6.18-ak7755-lineout-volume-a17.cpio.gz");
			type = "ramdisk";
			arch = "arm";
			os = "linux";
			compression = "gzip";
			hash-1 { algo = "sha256"; };
		};

		fdt-1 {
			description = "Phicomm R1 AK7755 timeout-backed amplifier gate";
			data = /incbin/("../build/artifacts/rk3229-phicomm-r1-mainline-6.18-ak7755-lineout-volume-a17.dtb");
			type = "flat_dt";
			arch = "arm";
			compression = "none";
			hash-1 { algo = "sha256"; };
		};
	};

	configurations {
		default = "config-1";
		config-1 {
			description = "R1 AK7755 Lineout1 0/-14/-30 dB noise A/B";
			kernel = "kernel-1";
			ramdisk = "ramdisk-1";
			fdt = "fdt-1";
		};
	};
};
```

## scripts/r1-linux-mainline-6.18-ak7755-pcm-clock-a5.its
```
/dts-v1/;

/ {
	description = "Phicomm R1 Linux 6.18 AK7755 zero-PCM clock A5";
	#address-cells = <1>;

	images {
		kernel-1 {
			description = "Linux 6.18.42 R1 AK7755 safe DAI A4 kernel";
			data = /incbin/("../build/artifacts/zImage-mainline-6.18-ak7755-dai-a4");
			type = "kernel";
			arch = "arm";
			os = "linux";
			compression = "none";
			load = <0x62000000>;
			entry = <0x62000000>;
			hash-1 { algo = "sha256"; };
		};

		ramdisk-1 {
			description = "R1 rescue initramfs with zero-PCM clock test";
			data = /incbin/("../build/artifacts/r1-initramfs-mainline-6.18-ak7755-pcm-clock-a5.cpio.gz");
			type = "ramdisk";
			arch = "arm";
			os = "linux";
			compression = "gzip";
			hash-1 { algo = "sha256"; };
		};

		fdt-1 {
			description = "Phicomm R1 AK7755 safe ASoC DAI A4 DTB";
			data = /incbin/("../build/artifacts/rk3229-phicomm-r1-mainline-6.18-ak7755-dai-a4.dtb");
			type = "flat_dt";
			arch = "arm";
			compression = "none";
			hash-1 { algo = "sha256"; };
		};
	};

	configurations {
		default = "config-1";
		config-1 {
			description = "R1 Linux 6.18 AK7755 zero-PCM clock A5";
			kernel = "kernel-1";
			ramdisk = "ramdisk-1";
			fdt = "fdt-1";
		};
	};
};
```

## scripts/r1-linux-mainline-6.18-ak7755-regdump-a22.its
```
/dts-v1/;

/ {
	description = "Phicomm R1 Linux 6.18 AK7755 read-only regdump A22";
	#address-cells = <1>;

	images {
		kernel-1 {
			description = "Linux 6.18.42 R1 AK7755 A20 reset-contract kernel";
			data = /incbin/("../build/artifacts/zImage-mainline-6.18-ak7755-reset-contract-a20");
			type = "kernel";
			arch = "arm";
			os = "linux";
			compression = "none";
			load = <0x62000000>;
			entry = <0x62000000>;
			hash-1 { algo = "sha256"; };
		};

		ramdisk-1 {
			description = "A19 rescue tools plus read-only AK7755 register dump";
			data = /incbin/("../build/artifacts/r1-initramfs-mainline-6.18-ak7755-regdump-a22.cpio.gz");
			type = "ramdisk";
			arch = "arm";
			os = "linux";
			compression = "gzip";
			hash-1 { algo = "sha256"; };
		};

		fdt-1 {
			description = "Phicomm R1 AK7755 timeout-backed amplifier gate";
			data = /incbin/("../build/artifacts/rk3229-phicomm-r1-mainline-6.18-ak7755-reset-contract-a20.dtb");
			type = "flat_dt";
			arch = "arm";
			compression = "none";
			hash-1 { algo = "sha256"; };
		};
	};

	configurations {
		default = "config-1";

		config-1 {
			description = "A20 hardware state with read-only register snapshots";
			kernel = "kernel-1";
			ramdisk = "ramdisk-1";
			fdt = "fdt-1";
		};
	};
};
```

## scripts/r1-linux-mainline-6.18-ak7755-reset-contract-a20.its
```
/dts-v1/;

/ {
	description = "Phicomm R1 Linux 6.18 AK7755 reset contract A20";
	#address-cells = <1>;

	images {
		kernel-1 {
			description = "Linux 6.18.42 R1 AK7755 datasheet reset contract";
			data = /incbin/("../build/artifacts/zImage-mainline-6.18-ak7755-reset-contract-a20");
			type = "kernel";
			arch = "arm";
			os = "linux";
			compression = "none";
			load = <0x62000000>;
			entry = <0x62000000>;
			hash-1 { algo = "sha256"; };
		};

		ramdisk-1 {
			description = "R1 A19 rescue initramfs with audible diagnostics";
			data = /incbin/("../build/artifacts/r1-initramfs-mainline-6.18-ak7755-i2s-clock-a19.cpio.gz");
			type = "ramdisk";
			arch = "arm";
			os = "linux";
			compression = "gzip";
			hash-1 { algo = "sha256"; };
		};

		fdt-1 {
			description = "Phicomm R1 AK7755 timeout-backed amplifier gate";
			data = /incbin/("../build/artifacts/rk3229-phicomm-r1-mainline-6.18-ak7755-lineout-selfcheck-a18r3.dtb");
			type = "flat_dt";
			arch = "arm";
			compression = "none";
			hash-1 { algo = "sha256"; };
		};
	};

	configurations {
		default = "config-1";
		config-1 {
			description = "R1 original reset contract audible A/B";
			kernel = "kernel-1";
			ramdisk = "ramdisk-1";
			fdt = "fdt-1";
		};
	};
};
```

## scripts/r1-linux-mainline-6.18-ak7755-sweep-a12.its
```
/dts-v1/;

/ {
	description = "Phicomm R1 Linux 6.18 controlled sweep A12";
	#address-cells = <1>;

	images {
		kernel-1 {
			description = "Linux 6.18.42 R1 fail-closed audio A9 kernel";
			data = /incbin/("../build/artifacts/zImage-mainline-6.18-ak7755-channel-a9");
			type = "kernel";
			arch = "arm";
			os = "linux";
			compression = "none";
			load = <0x62000000>;
			entry = <0x62000000>;
			hash-1 { algo = "sha256"; };
		};

		ramdisk-1 {
			description = "R1 rescue initramfs with controlled three-level sweep";
			data = /incbin/("../build/artifacts/r1-initramfs-mainline-6.18-ak7755-sweep-a12.cpio.gz");
			type = "ramdisk";
			arch = "arm";
			os = "linux";
			compression = "gzip";
			hash-1 { algo = "sha256"; };
		};

		fdt-1 {
			description = "Phicomm R1 AK7755 timeout-backed amplifier gate A9";
			data = /incbin/("../build/artifacts/rk3229-phicomm-r1-mainline-6.18-ak7755-channel-a9.dtb");
			type = "flat_dt";
			arch = "arm";
			compression = "none";
			hash-1 { algo = "sha256"; };
		};
	};

	configurations {
		default = "config-1";
		config-1 {
			description = "R1 300 Hz to 2 kHz sweeps at -60/-54/-48 dBFS";
			kernel = "kernel-1";
			ramdisk = "ramdisk-1";
			fdt = "fdt-1";
		};
	};
};
```

## scripts/r1-linux-multiv7-v9-emmc-c1.its
```
/dts-v1/;

/*
 * C1 config A/B after the trimmed v11 kernel failed to bring CPU1-CPU3
 * online with the eMMC B2 device tree.
 *
 * Reuse the exact multi_v7-based clean-v9 zImage already verified with four
 * CPUs.  Keep the B2 timer-minimal DTB and fixed initramfs byte-for-byte.
 */
/ {
	description = "Phicomm R1 Linux 5.10 multi_v7 v9 eMMC C1";
	#address-cells = <1>;

	images {
		kernel {
			description = "Verified Linux 5.10.262 multi_v7 clean four-core v9";
			data = /incbin/("../build/artifacts/zImage-5.10-psci-v1-gic400-clean-4core-v9");
			type = "kernel";
			arch = "arm";
			os = "linux";
			compression = "none";
			load = <0x62000000>;
			entry = <0x62000000>;
			hash-1 { algo = "sha256"; };
		};

		ramdisk {
			description = "R1 rescue initramfs with basic applets";
			data = /incbin/("../build/artifacts/r1-initramfs-rescue-v11-emmc-a2.cpio.gz");
			type = "ramdisk";
			arch = "arm";
			os = "linux";
			compression = "none";
			load = <0x64000000>;
			hash-1 { algo = "sha256"; };
		};

		fdt {
			description = "R1 eMMC B2 timer-minimal DT";
			data = /incbin/("../build/artifacts/rk3229-phicomm-r1-rescue-v11-emmc-a2-timer-minimal.dtb");
			type = "flat_dt";
			arch = "arm";
			compression = "none";
			load = <0x65000000>;
			hash-1 { algo = "sha256"; };
		};
	};

	configurations {
		default = "config-1";

		config-1 {
			description = "R1 multi_v7 v9 kernel plus eMMC B2 DT";
			kernel = "kernel";
			ramdisk = "ramdisk";
			fdt = "fdt";
		};
	};
};
```

## scripts/r1-linux-multiv7-v9-emmc-usb-host-a1.its
```
/dts-v1/;

/*
 * USB Host A1: exact verified C1 kernel/initramfs, with only the DTB changed.
 */
/ {
	description = "Phicomm R1 Linux 5.10 C1 plus USB Host A1";
	#address-cells = <1>;

	images {
		kernel {
			description = "Verified Linux 5.10.262 multi_v7 clean four-core v9";
			data = /incbin/("../build/artifacts/zImage-5.10-psci-v1-gic400-clean-4core-v9");
			type = "kernel";
			arch = "arm";
			os = "linux";
			compression = "none";
			load = <0x62000000>;
			entry = <0x62000000>;
			hash-1 { algo = "sha256"; };
		};

		ramdisk {
			description = "R1 rescue initramfs with basic applets";
			data = /incbin/("../build/artifacts/r1-initramfs-rescue-v11-emmc-a2.cpio.gz");
			type = "ramdisk";
			arch = "arm";
			os = "linux";
			compression = "none";
			load = <0x64000000>;
			hash-1 { algo = "sha256"; };
		};

		fdt {
			description = "Verified eMMC C1 DT plus fixed USB Host controllers";
			data = /incbin/("../build/artifacts/rk3229-phicomm-r1-emmc-open-optee-usb-host-a1.dtb");
			type = "flat_dt";
			arch = "arm";
			compression = "none";
			load = <0x65000000>;
			hash-1 { algo = "sha256"; };
		};
	};

	configurations {
		default = "config-1";

		config-1 {
			description = "R1 C1 plus USB Host A1";
			kernel = "kernel";
			ramdisk = "ramdisk";
			fdt = "fdt";
		};
	};
};
```

## scripts/r1-linux-multiv7-v9-emmc-wifi-brcmfmac-a2.its
```
/dts-v1/;

/* Wi-Fi A2: proven SDIO A1 DT plus built-in brcmfmac and R1 firmware. */
/ {
	description = "Phicomm R1 Linux 5.10 Wi-Fi brcmfmac A2";
	#address-cells = <1>;

	images {
		kernel {
			description = "Linux 5.10.262 multi_v7 four-core plus brcmfmac SDIO";
			data = /incbin/("../build/artifacts/zImage-5.10-multiv7-v9-wifi-a2");
			type = "kernel";
			arch = "arm";
			os = "linux";
			compression = "none";
			load = <0x62000000>;
			entry = <0x62000000>;
			hash-1 { algo = "sha256"; };
		};

		ramdisk {
			description = "R1 rescue initramfs plus BCM43455/AP6255 firmware";
			data = /incbin/("../build/artifacts/r1-initramfs-wifi-a2.cpio.gz");
			type = "ramdisk";
			arch = "arm";
			os = "linux";
			compression = "none";
			load = <0x64000000>;
			hash-1 { algo = "sha256"; };
		};

		fdt {
			description = "R1 verified Wi-Fi SDIO A1 hardware DT";
			data = /incbin/("../build/artifacts/rk3229-phicomm-r1-emmc-open-optee-wifi-sdio-a1.dtb");
			type = "flat_dt";
			arch = "arm";
			compression = "none";
			load = <0x65000000>;
			hash-1 { algo = "sha256"; };
		};
	};

	configurations {
		default = "config-1";

		config-1 {
			description = "R1 Wi-Fi brcmfmac A2";
			kernel = "kernel";
			ramdisk = "ramdisk";
			fdt = "fdt";
		};
	};
};
```

## scripts/r1-linux-multiv7-v9-emmc-wifi-regulatory-a3.its
```
/dts-v1/;

/* Wi-Fi A3a: A2 plus regulatory.db, CN initial domain and BCM43455 CLM. */
/ {
	description = "Phicomm R1 Linux 5.10 Wi-Fi regulatory A3a";
	#address-cells = <1>;

	images {
		kernel {
			description = "Linux 5.10.262 multi_v7 four-core Wi-Fi A3a";
			data = /incbin/("../build/artifacts/zImage-5.10-multiv7-v9-wifi-a3");
			type = "kernel";
			arch = "arm";
			os = "linux";
			compression = "none";
			load = <0x62000000>;
			entry = <0x62000000>;
			hash-1 { algo = "sha256"; };
		};

		ramdisk {
			description = "R1 rescue initramfs plus BCM43455 firmware and regulatory data";
			data = /incbin/("../build/artifacts/r1-initramfs-wifi-a3.cpio.gz");
			type = "ramdisk";
			arch = "arm";
			os = "linux";
			compression = "none";
			load = <0x64000000>;
			hash-1 { algo = "sha256"; };
		};

		fdt {
			description = "R1 verified Wi-Fi SDIO A1 hardware DT";
			data = /incbin/("../build/artifacts/rk3229-phicomm-r1-emmc-open-optee-wifi-sdio-a1.dtb");
			type = "flat_dt";
			arch = "arm";
			compression = "none";
			load = <0x65000000>;
			hash-1 { algo = "sha256"; };
		};
	};

	configurations {
		default = "config-1";

		config-1 {
			description = "R1 Wi-Fi regulatory A3a";
			kernel = "kernel";
			ramdisk = "ramdisk";
			fdt = "fdt";
		};
	};
};
```
