## buildroot-external/r1/configs/phicomm_r1_bluealsa_defconfig
```kconfig
BR2_arm=y
BR2_cortex_a7=y
BR2_ARM_EABIHF=y
BR2_TOOLCHAIN_BUILDROOT_MUSL=y
BR2_KERNEL_HEADERS_6_18=y
BR2_REPRODUCIBLE=y
BR2_TARGET_GENERIC_HOSTNAME="phicomm-r1"
BR2_TARGET_GENERIC_ISSUE="Phicomm R1 RAM-only BlueALSA lab"
BR2_INIT_BUSYBOX=y
BR2_ROOTFS_DEVICE_CREATION_DYNAMIC_DEVTMPFS=y
BR2_TARGET_ENABLE_ROOT_LOGIN=y
BR2_TARGET_GENERIC_ROOT_PASSWD=""
BR2_TARGET_GENERIC_GETTY_PORT="console"
BR2_TARGET_GENERIC_GETTY_BAUDRATE_KEEP=y
BR2_ROOTFS_OVERLAY="$(BR2_EXTERNAL_R1_PATH)/board/phicomm/r1/rootfs-overlay"
BR2_ROOTFS_POST_BUILD_SCRIPT="$(BR2_EXTERNAL_R1_PATH)/board/phicomm/r1/post-build.sh"
BR2_GLOBAL_PATCH_DIR="$(BR2_EXTERNAL_R1_PATH)/patches"
BR2_PACKAGE_DBUS=y
BR2_PACKAGE_ALSA_LIB=y
BR2_PACKAGE_ALSA_UTILS=y
# BR2_PACKAGE_ALSA_UTILS_ALSAMIXER is not set
BR2_PACKAGE_ALSA_UTILS_AMIXER=y
BR2_PACKAGE_ALSA_UTILS_APLAY=y
BR2_PACKAGE_BLUEZ_ALSA=y
BR2_PACKAGE_ALSA_PLUGINS=y
BR2_PACKAGE_BLUEZ5_UTILS=y
BR2_PACKAGE_BLUEZ5_UTILS_CLIENT=y
BR2_PACKAGE_BLUEZ5_UTILS_PLUGINS_AUDIO=y
# BR2_PACKAGE_BLUEZ5_UTILS_PLUGINS_NETWORK is not set
BR2_TARGET_ROOTFS_CPIO=y
BR2_TARGET_ROOTFS_CPIO_GZIP=y
```

## kernel/overlays/linux-6.18.42/Documentation/devicetree/bindings/sound/akm,ak7755.yaml
```yaml
# SPDX-License-Identifier: (GPL-2.0-or-later OR BSD-2-Clause)
%YAML 1.2
---
$id: http://devicetree.org/schemas/sound/akm,ak7755.yaml#
$schema: http://devicetree.org/meta-schemas/core.yaml#

title: AKM AK7755 audio DSP

maintainers:
  - Phicomm R1 Linux contributors

description: |
  The AK7755 is a RAM-based audio DSP with ADC, DAC and serial audio ports.
  Program and coefficient RAM images are downloaded through I2C or SPI.
  The binding covers the verified I2C control path and the board-constrained
  serial audio DAI. External amplifier control is board specific.

properties:
  compatible:
    const: akm,ak7755

  '#sound-dai-cells':
    const: 0

  reg:
    maxItems: 1

  reset-gpios:
    description: Active-low hardware power-down/reset input.
    maxItems: 1

  safe-supply:
    description: |
      Optional board-level prerequisite that keeps downstream amplifiers safe.
      Boards whose machine driver exclusively owns a fail-closed amplifier
      gate may omit this supply.

  akm,pram-firmware:
    description: PRAM image including its AK7755 RAM-write command header.
    $ref: /schemas/types.yaml#/definitions/string
    default: ak7755_pram_data2.bin

  akm,cram-firmware:
    description: CRAM image including its AK7755 RAM-write command header.
    $ref: /schemas/types.yaml#/definitions/string
    default: ak7755_cram_data2.bin

required:
  - compatible
  - reg
  - reset-gpios

additionalProperties: false

examples:
  - |
    i2c {
        #address-cells = <1>;
        #size-cells = <0>;

        audio-dsp@19 {
            compatible = "akm,ak7755";
            reg = <0x19>;
            reset-gpios = <&gpio1 3 1>;
            safe-supply = <&amp_mute_safe>;
            akm,pram-firmware = "ak7755_pram_data2.bin";
            akm,cram-firmware = "ak7755_cram_data2.bin";
        };
    };
...
```

## kernel/overlays/linux-6.18.42/Documentation/devicetree/bindings/sound/phicomm,r1-ak7755-sound.yaml
```yaml
# SPDX-License-Identifier: (GPL-2.0-or-later OR BSD-2-Clause)
%YAML 1.2
---
$id: http://devicetree.org/schemas/sound/phicomm,r1-ak7755-sound.yaml#
$schema: http://devicetree.org/meta-schemas/core.yaml#

title: Phicomm R1 AK7755 sound card

maintainers:
  - Phicomm R1 Linux contributors

description: |
  Minimal machine link between the RK3229 I2S2 controller and the AK7755 on
  the Phicomm R1. The CPU provides BCLK and LRCK. The first implementation is
  deliberately restricted to 48 kHz, stereo, 16-bit PCM and does not control
  the external amplifier.

properties:
  compatible:
    const: phicomm,r1-ak7755-sound

  phicomm,cpu-dai:
    $ref: /schemas/types.yaml#/definitions/phandle

  phicomm,audio-codec:
    $ref: /schemas/types.yaml#/definitions/phandle

required:
  - compatible
  - phicomm,cpu-dai
  - phicomm,audio-codec

additionalProperties: false

examples:
  - |
    sound {
        compatible = "phicomm,r1-ak7755-sound";
        phicomm,cpu-dai = <&i2s2>;
        phicomm,audio-codec = <&ak7755>;
    };
...
```

## scripts/r1-linux-factory-3.10-ak7755-tone-a21r4.its
```
/dts-v1/;

/ {
	description = "Phicomm R1 factory AK7755 zero/tone positive control A21r4";
	#address-cells = <1>;

	images {
		kernel-1 {
			description = "Locally preserved R1 factory Linux 3.10 kernel";
			data = /incbin/("../backup/unpacked/boot/kernel");
			type = "kernel";
			arch = "arm";
			os = "linux";
			compression = "none";
			load = <0x60408000>;
			entry = <0x60408000>;
			hash-1 { algo = "sha256"; };
		};

		ramdisk-1 {
			description = "Read-only rescue with zero and low-level tone tools";
			data = /incbin/("../build/artifacts/r1-initramfs-factory-3.10-ak7755-tone-a21r4.cpio.gz");
			type = "ramdisk";
			arch = "arm";
			os = "linux";
			compression = "gzip";
			hash-1 { algo = "sha256"; };
		};

		fdt-1 {
			description = "Factory AK7755 audio-only DT from A21r3";
			data = /incbin/("../build/artifacts/rk3229-phicomm-r1-factory-open-optee-audio-only-a21r3.dtb");
			type = "flat_dt";
			arch = "arm";
			compression = "none";
			hash-1 { algo = "sha256"; };
		};
	};

	configurations {
		default = "config-1";

		config-1 {
			description = "Factory AK7755 zero/tone positive-control pair";
			kernel = "kernel-1";
			ramdisk = "ramdisk-1";
			fdt = "fdt-1";
		};
	};
};
```

## scripts/r1-linux-factory-3.10-audio-ab-a21r3.its
```
/dts-v1/;

/ {
	description = "Phicomm R1 factory Linux 3.10 AK7755 A/B A21r3";
	#address-cells = <1>;

	images {
		kernel-1 {
			description = "Locally preserved R1 factory Linux 3.10 kernel";
			data = /incbin/("../backup/unpacked/boot/kernel");
			type = "kernel";
			arch = "arm";
			os = "linux";
			compression = "none";
			load = <0x60408000>;
			entry = <0x60408000>;
			hash-1 { algo = "sha256"; };
		};

		ramdisk-1 {
			description = "Read-only R1 rescue initramfs with zero-PCM tool";
			data = /incbin/("../build/artifacts/r1-initramfs-mainline-6.18-ak7755-i2s-clock-a19.cpio.gz");
			type = "ramdisk";
			arch = "arm";
			os = "linux";
			compression = "gzip";
			hash-1 { algo = "sha256"; };
		};

		fdt-1 {
			description = "Factory AK7755 audio DT; storage/wireless/other cards disabled";
			data = /incbin/("../build/artifacts/rk3229-phicomm-r1-factory-open-optee-audio-only-a21r3.dtb");
			type = "flat_dt";
			arch = "arm";
			compression = "none";
			hash-1 { algo = "sha256"; };
		};
	};

	configurations {
		default = "config-1";

		config-1 {
			description = "Factory AK7755 card-0 zero-PCM comparison";
			kernel = "kernel-1";
			ramdisk = "ramdisk-1";
			fdt = "fdt-1";
		};
	};
};
```

## scripts/r1-linux-mainline-6.18-ak7755-audio-soak-a7.its
```
/dts-v1/;

/ {
	description = "Phicomm R1 Linux 6.18 AK7755 audio soak A7r2";
	#address-cells = <1>;

	images {
		kernel-1 {
			description = "Linux 6.18.42 R1 AK7755 full-duplex soak A7";
			data = /incbin/("../build/artifacts/zImage-mainline-6.18-ak7755-audio-soak-a7");
			type = "kernel";
			arch = "arm";
			os = "linux";
			compression = "none";
			load = <0x62000000>;
			entry = <0x62000000>;
			hash-1 { algo = "sha256"; };
		};

		ramdisk-1 {
			description = "R1 rescue initramfs with integrated audio soak";
			data = /incbin/("../build/artifacts/r1-initramfs-mainline-6.18-ak7755-audio-soak-a7.cpio.gz");
			type = "ramdisk";
			arch = "arm";
			os = "linux";
			compression = "gzip";
			hash-1 { algo = "sha256"; };
		};

		fdt-1 {
			description = "Phicomm R1 AK7755 safe ASoC DAI A4 DTB";
			data = /incbin/("../build/artifacts/rk3229-phicomm-r1-mainline-6.18-ak7755-audio-soak-a7.dtb");
			type = "flat_dt";
			arch = "arm";
			compression = "none";
			hash-1 { algo = "sha256"; };
		};
	};

	configurations {
		default = "config-1";
		config-1 {
			description = "R1 Linux 6.18 AK7755 integrated audio soak A7r2";
			kernel = "kernel-1";
			ramdisk = "ramdisk-1";
			fdt = "fdt-1";
		};
	};
};
```

## scripts/r1-linux-mainline-6.18-ak7755-bluealsa-a25.its
```
/dts-v1/;

/ {
	description = "Phicomm R1 Linux 6.18 Buildroot BlueALSA A25";
	#address-cells = <1>;

	images {
		kernel-1 {
			description = "Linux 6.18.42 R1 AK7755 automatic PCM amplifier";
			data = /incbin/("../build/artifacts/zImage-mainline-6.18-ak7755-auto-amp-a24");
			type = "kernel";
			arch = "arm";
			os = "linux";
			compression = "none";
			load = <0x62000000>;
			entry = <0x62000000>;
			hash-1 { algo = "sha256"; };
		};

		ramdisk-1 {
			description = "Buildroot 2026.05.1 BlueZ 5.79 BlueALSA 4.3.1 SBC rootfs";
			data = /incbin/("../build/buildroot-r1-bluealsa-6.18/images/rootfs.cpio.gz");
			type = "ramdisk";
			arch = "arm";
			os = "linux";
			compression = "gzip";
			hash-1 { algo = "sha256"; };
		};

		fdt-1 {
			description = "Phicomm R1 AK7755 automatic amplifier fail-safe DT";
			data = /incbin/("../build/artifacts/rk3229-phicomm-r1-mainline-6.18-ak7755-auto-amp-a24.dtb");
			type = "flat_dt";
			arch = "arm";
			compression = "none";
			hash-1 { algo = "sha256"; };
		};
	};

	configurations {
		default = "config-1";
		config-1 {
			description = "R1 A25 ordinary ALSA plus SBC A2DP sink";
			kernel = "kernel-1";
			ramdisk = "ramdisk-1";
			fdt = "fdt-1";
		};
	};
};
```

## scripts/r1-linux-mainline-6.18-ak7755-channel-a9.its
```
/dts-v1/;

/ {
	description = "Phicomm R1 Linux 6.18 conservative channel test A9r2";
	#address-cells = <1>;

	images {
		kernel-1 {
			description = "Linux 6.18.42 R1 fail-closed channel test A9r2";
			data = /incbin/("../build/artifacts/zImage-mainline-6.18-ak7755-channel-a9");
			type = "kernel";
			arch = "arm";
			os = "linux";
			compression = "none";
			load = <0x62000000>;
			entry = <0x62000000>;
			hash-1 { algo = "sha256"; };
		};

		ramdisk-1 {
			description = "R1 rescue initramfs with 3.072 s channel gap A9r2";
			data = /incbin/("../build/artifacts/r1-initramfs-mainline-6.18-ak7755-channel-a9.cpio.gz");
			type = "ramdisk";
			arch = "arm";
			os = "linux";
			compression = "gzip";
			hash-1 { algo = "sha256"; };
		};

		fdt-1 {
			description = "Phicomm R1 AK7755 timeout-backed amplifier gate A9r2";
			data = /incbin/("../build/artifacts/rk3229-phicomm-r1-mainline-6.18-ak7755-channel-a9.dtb");
			type = "flat_dt";
			arch = "arm";
			compression = "none";
			hash-1 { algo = "sha256"; };
		};
	};

	configurations {
		default = "config-1";
		config-1 {
			description = "R1 Linux 6.18 left/right -60 dBFS channel test A9r2";
			kernel = "kernel-1";
			ramdisk = "ramdisk-1";
			fdt = "fdt-1";
		};
	};
};
```

## scripts/r1-linux-mainline-6.18-ak7755-dac-mute-a15.its
```
/dts-v1/;

/ {
	description = "Phicomm R1 Linux 6.18 AK7755 DAC mute A15";
	#address-cells = <1>;

	images {
		kernel-1 {
			description = "Linux 6.18.42 R1 AK7755 DAC soft-mute diagnostic";
			data = /incbin/("../build/artifacts/zImage-mainline-6.18-ak7755-dac-mute-a15");
			type = "kernel";
			arch = "arm";
			os = "linux";
			compression = "none";
			load = <0x62000000>;
			entry = <0x62000000>;
			hash-1 { algo = "sha256"; };
		};

		ramdisk-1 {
			description = "R1 rescue initramfs with AK7755 DAC mute A/B tool";
			data = /incbin/("../build/artifacts/r1-initramfs-mainline-6.18-ak7755-dac-mute-a15.cpio.gz");
			type = "ramdisk";
			arch = "arm";
			os = "linux";
			compression = "gzip";
			hash-1 { algo = "sha256"; };
		};

		fdt-1 {
			description = "Phicomm R1 AK7755 timeout-backed amplifier gate";
			data = /incbin/("../build/artifacts/rk3229-phicomm-r1-mainline-6.18-ak7755-dac-mute-a15.dtb");
			type = "flat_dt";
			arch = "arm";
			compression = "none";
			hash-1 { algo = "sha256"; };
		};
	};

	configurations {
		default = "config-1";
		config-1 {
			description = "R1 direct route AK7755 DAC mute boundary A/B";
			kernel = "kernel-1";
			ramdisk = "ramdisk-1";
			fdt = "fdt-1";
		};
	};
};
```

## scripts/r1-linux-mainline-6.18-ak7755-dai-a4.its
```
/dts-v1/;

/ {
	description = "Phicomm R1 Linux 6.18 AK7755 safe DAI A4";
	#address-cells = <1>;

	images {
		kernel-1 {
			description = "Linux 6.18.42 R1 four-core Wi-Fi Bluetooth AK7755 DAI";
			data = /incbin/("../build/artifacts/zImage-mainline-6.18-ak7755-dai-a4");
			type = "kernel";
			arch = "arm";
			os = "linux";
			compression = "none";
			load = <0x62000000>;
			entry = <0x62000000>;
			hash-1 { algo = "sha256"; };
		};

		ramdisk-1 {
			description = "R1 rescue initramfs with wireless and AK7755 firmware";
			data = /incbin/("../build/artifacts/r1-initramfs-mainline-6.18-ak7755-dai-a4.cpio.gz");
			type = "ramdisk";
			arch = "arm";
			os = "linux";
			compression = "gzip";
			hash-1 { algo = "sha256"; };
		};

		fdt-1 {
			description = "Phicomm R1 AK7755 safe ASoC DAI DTB";
			data = /incbin/("../build/artifacts/rk3229-phicomm-r1-mainline-6.18-ak7755-dai-a4.dtb");
			type = "flat_dt";
			arch = "arm";
			compression = "none";
			hash-1 { algo = "sha256"; };
		};
	};

	configurations {
		default = "config-1";
		config-1 {
			description = "R1 Linux 6.18 AK7755 safe DAI A4";
			kernel = "kernel-1";
			ramdisk = "ramdisk-1";
			fdt = "fdt-1";
		};
	};
};
```

## scripts/r1-linux-mainline-6.18-ak7755-direct-a13a.its
```
/dts-v1/;

/ {
	description = "Phicomm R1 Linux 6.18 AK7755 direct-output A13a";
	#address-cells = <1>;

	images {
		kernel-1 {
			description = "Linux 6.18.42 R1 AK7755 SDIN1 direct-output diagnostic";
			data = /incbin/("../build/artifacts/zImage-mainline-6.18-ak7755-direct-a13a");
			type = "kernel";
			arch = "arm";
			os = "linux";
			compression = "none";
			load = <0x62000000>;
			entry = <0x62000000>;
			hash-1 { algo = "sha256"; };
		};

		ramdisk-1 {
			description = "R1 rescue initramfs with lowest-level audible test";
			data = /incbin/("../build/artifacts/r1-initramfs-mainline-6.18-ak7755-sweep-a12.cpio.gz");
			type = "ramdisk";
			arch = "arm";
			os = "linux";
			compression = "gzip";
			hash-1 { algo = "sha256"; };
		};

		fdt-1 {
			description = "Phicomm R1 AK7755 timeout-backed amplifier gate";
			data = /incbin/("../build/artifacts/rk3229-phicomm-r1-mainline-6.18-ak7755-direct-a13a.dtb");
			type = "flat_dt";
			arch = "arm";
			compression = "none";
			hash-1 { algo = "sha256"; };
		};
	};

	configurations {
		default = "config-1";
		config-1 {
			description = "R1 SDIN1 to DAC and Lineout1 direct route; DSP held reset";
			kernel = "kernel-1";
			ramdisk = "ramdisk-1";
			fdt = "fdt-1";
		};
	};
};
```

## scripts/r1-linux-mainline-6.18-ak7755-factory-dsp-a23.its
```
/dts-v1/;

/ {
	description = "Phicomm R1 Linux 6.18 factory DSP route A23";
	#address-cells = <1>;

	images {
		kernel-1 {
			description = "Linux 6.18.42 R1 AK7755 factory data2 DSP route";
			data = /incbin/("../build/artifacts/zImage-mainline-6.18-ak7755-factory-dsp-a23");
			type = "kernel";
			arch = "arm";
			os = "linux";
			compression = "none";
			load = <0x62000000>;
			entry = <0x62000000>;
			hash-1 { algo = "sha256"; };
		};

		ramdisk-1 {
			description = "R1 rescue initramfs with factory-DSP audible test";
			data = /incbin/("../build/artifacts/r1-initramfs-mainline-6.18-ak7755-factory-dsp-a23.cpio.gz");
			type = "ramdisk";
			arch = "arm";
			os = "linux";
			compression = "gzip";
			hash-1 { algo = "sha256"; };
		};

		fdt-1 {
			description = "Phicomm R1 AK7755 provider-clock fail-safe DT";
			data = /incbin/("../build/artifacts/rk3229-phicomm-r1-mainline-6.18-ak7755-factory-dsp-a23.dtb");
			type = "flat_dt";
			arch = "arm";
			compression = "none";
			hash-1 { algo = "sha256"; };
		};
	};

	configurations {
		default = "config-1";
		config-1 {
			description = "R1 A23 factory data2 DSP route with gated PA";
			kernel = "kernel-1";
			ramdisk = "ramdisk-1";
			fdt = "fdt-1";
		};
	};
};
```
