/dts-v1/;
/plugin/;

/*
 * RAM-only diagnostic overlay for the locally preserved factory R1 DTB.
 *
 * Keep this file free of factory DT contents: it only reserves the open
 * OP-TEE runtime range and replaces Android boot arguments with the rescue
 * initramfs contract.  maxcpus=1 deliberately removes SMP/PSCI as a variable
 * from the factory-codec idle-noise comparison.
 */

/ {
	fragment@0 {
		target-path = "/";

		__overlay__ {
			reserved-memory {
				#address-cells = <1>;
				#size-cells = <1>;
				ranges;

				optee@68400000 {
					reg = <0x68400000 0x00300000>;
					no-map;
				};
			};
		};
	};

	fragment@1 {
		target-path = "/chosen";

		__overlay__ {
			bootargs = "console=ttyFIQ0,1500000n8 androidboot.console=ttyFIQ0 vmalloc=496M psci=enable rockchip_jtag maxcpus=1 rdinit=/init loglevel=8 ignore_loglevel";
		};
	};
};
